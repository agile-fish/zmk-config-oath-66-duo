## config/boards/shields/oath-66-duo/Kconfig.defconfig
```kconfig
if SHIELD_MY_KEYBOARD_LEFT

# Name must be less than 16 characters long!
config ZMK_KEYBOARD_NAME
    default "oath_pro"

config ZMK_SPLIT_ROLE_CENTRAL
    default y

endif

if SHIELD_OATH_PRO_LEFT || SHIELD_OATH_PRO_RIGHT

config ZMK_SPLIT
    default y

endif
```

## config/boards/shields/oath_pro/Kconfig.shield
```kconfig
# No whitespace after the comma or in your part name!
config SHIELD_OATH_PRO_LEFT
    def_bool $(shields_list_contains,oath_pro_left)

# No whitespace after the comma or in your part name!
config SHIELD_OATH_PRO_RIGHT
    def_bool $(shields_list_contains,oath_pro_right)

# No whitespace after the comma or in the keyboard name!
config SHIELD_OATH_PRO_DONGLE
    def_bool $(shields_list_contains,oath_pro_dongle)
```
